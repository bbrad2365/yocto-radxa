## meta-radxa/conf/machine/zero-3w.conf
```bitbake
#@TYPE: Machine
#@NAME: Radxa Zero 3w
#@DESCRIPTION: ZERO3 is a series of Rockchip RK3566 based SBC(Single Board Computer) and Compute Module by Radxa.
#https://docs.radxa.com/en/zero/zero3

require conf/machine/include/rk3568.inc

KERNEL_DEVICETREE = "rockchip/rk3566-radxa-zero-3w.dtb"
MACHINE_EXTRA_RRECOMMENDS += "kernel-modules"

UBOOT_MACHINE = "rock-3a-rk3568_defconfig"
```
